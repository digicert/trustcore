#########################################################
#  makefile_defines_lkm.inc
#
# Copyright Mocana Corp 2016. All Rights Reserved.
# Proprietary and Confidential Material.
#
#########################################################

MOC_CFLAGS += \
-D__ENABLE_DIGICERT_GCM_64K__ \
-D__ENABLE_DIGICERT_GCM_4K__ \
-D__ENABLE_DIGICERT_GCM_256B__ \
-D__ENABLE_DES_CIPHER__ \
-D__ENABLE_DIGICERT_MD4__ \
-D__ENABLE_DIGICERT_MD2__ \
-D__ENABLE_DIGICERT_SHA3__ \
-D__ENABLE_DIGICERT_IPSEC_SERVICE__ \
-D__DISABLE_DIGICERT_PUB_CRYPTO_SERIALIZATION__ \
-D__ENABLE_DIGICERT_RNG_DRBG_CTR__ \
-Dxxxxx__ENABLE_DIGICERT_FIPS_MODULE__ \
-D__ENABLE_DIGICERT_FIPS_RANDOM__ \
-D__ENABLE_DIGICERT_FIPS_SHA1__ \
-D__ENABLE_DIGICERT_FIPS_SHA256__ \
-D__ENABLE_DIGICERT_FIPS_SHA512__ \
-D__ENABLE_DIGICERT_FIPS_SHA3__ \
-D__ENABLE_DIGICERT_FIPS_HMAC__ \
-D__ENABLE_DIGICERT_FIPS_3DES__ \
-D__ENABLE_DIGICERT_FIPS_AES__ \
-Dxxxxx__ENABLE_FIPS_POWERUP_TEST__ \
-Dxxxxx__ENABLE_DIGICERT_FIPS_INTEG_TEST__ \
-D__MOC_PLATFORM_MODULE__ \
-D__DISABLE_DIGICERT_RAND_ENTROPY_THREADS__ \
-D__ENABLE_DIGICERT_CRYPTO_KERNEL_MODULE_FIPS__ \
-D__DISABLE_DIGICERT_FILE_SYSTEM_HELPER__ \
-D__DIGICERT_DSF_VERSION_STR__=\"$(MSS_VERSION_STR)\" \
-D__DIGICERT_DSF_BUILD_STR__=\"$(MSS_BUILD_STR)\" \
-D__DIGICERT_DSF_BUILDTIME_STR__=\"$(MSS_BUILDTIME_STR)\"

########################
## Kernel module rationale
########################
## The following must be there in the final FIPS deliverable binaries.
## -D__ENABLE_DIGICERT_FIPS_INTEG_TEST__
## -D__ENABLE_DIGICERT_FIPS_MODULE__
## -D__DISABLE_DIGICERT_RAND_ENTROPY_THREADS__
## -D__ENABLE_DIGICERT_CRYPTO_KERNEL_MODULE_FIPS__

