/*
 * fips_kat_mlkem_decap_data.inc
 *
 * FIPS 140-3 Self Test Compliance Data
 *
 * Copyright 2026 DigiCert, Inc. All Rights Reserved.
 *
 * DigiCert® TrustCore SDK and TrustEdge are licensed under a dual-license model:
 *
 * 1. **Open Source License**: GNU Affero General Public License v3.0 (AGPL v3).
 * See: https://github.com/digicert/trustcore/blob/main/LICENSE.md
 * 2. **Commercial License**: Available under DigiCert's Master Services Agreement.
 * See: https://www.digicert.com/master-services-agreement/
 *
 * *Use of TrustCore SDK or TrustEdge outside the scope of AGPL v3 requires a commercial license.*
 * *Contact DigiCert at sales@digicert.com for more details.*
 *
 */

#ifdef __ENABLE_DIGICERT_FIPS_MODULE__

/************************************************************************
 * Data values for the 'fips_kat' logic checking the ML-KEM decapsulation
 * algorithm.
 ************************************************************************/

static const ubyte  decKey[] = {
	0xff, 0x64, 0xae, 0xec, 0xa0, 0xa2, 0x42, 0xeb, 0x42, 0x03, 0x3b, 0x23,
	0xc2, 0x4a, 0xa2, 0xeb, 0x36, 0x16, 0x84, 0x38, 0xcd, 0x71, 0xbc, 0x96,
	0x8e, 0xa5, 0x00, 0xd4, 0x88, 0x56, 0x0c, 0xf9, 0xc4, 0xd5, 0x02, 0x29,
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	0xba, 0x36, 0x45, 0x15, 0xcc, 0x51, 0x74, 0xe3, 0x87, 0x02, 0x04, 0x9a
    };
static const ubyte4 decKeyLen = sizeof(decKey);

static const ubyte  cipher[] = {
	0xab, 0xa2, 0xe9, 0x16, 0x6f, 0xec, 0xa7, 0xf0, 0xd7, 0xc9, 0x62, 0x8f,
	0xe0, 0x1a, 0x46, 0xf5, 0x9a, 0x82, 0x18, 0x8c, 0x49, 0xba, 0x0a, 0xca,
	0xd7, 0xaf, 0xe2, 0x9d, 0xe2, 0x28, 0x9f, 0x25, 0x57, 0x16, 0x44, 0x8d,
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	0xd0, 0x47, 0xcc, 0xbb, 0x7d, 0xbf, 0x84, 0x16, 0x92, 0xad, 0x01, 0x76
    };
static const ubyte4 cipherLen = sizeof(cipher);

static const ubyte check[] = {
	0x6c, 0x9a, 0xb0, 0xd6, 0x2c, 0x4c, 0xe2, 0xc8, 0x09, 0x8e, 0xb8, 0xc0,
	0xa3, 0xe8, 0xf0, 0xe4, 0x9a, 0x6b, 0xac, 0xc8, 0x33, 0xff, 0x65, 0x7d,
	0x7a, 0xaa, 0xe4, 0x6a, 0x2c, 0x31, 0xeb, 0x46
    };
static const ubyte4 checkLen = sizeof(check);

/********************************************/
/* Created with:                            */
/* $ dd if=/dev/zero of=c.bin count=768     */
/* Save 'decKey' value in dk.bin            */
/* $ dd if=dk.bin of=z.bin bs=1600 skip=1   */
/* $ cat z.bin c.bin > K.bin                */
/* $ openssl dgst -shake256 K.bin           */
/********************************************/
static const ubyte check_reject[] = {
        0x93, 0xe2, 0x16, 0xf9, 0x79, 0xa8, 0x53, 0x2d, 0xec, 0x18, 0x4d, 0x30,
        0xf5, 0x3c, 0xfd, 0x17, 0x4f, 0x04, 0x6d, 0x87, 0xcb, 0x2d, 0x15, 0x1f,
        0x5d, 0x31, 0x26, 0xfa, 0xa2, 0xd9, 0x29, 0xc0
    };

#endif /* __ENABLE_DIGICERT_FIPS_MODULE__ */
