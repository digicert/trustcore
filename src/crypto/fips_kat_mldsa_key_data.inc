/*
 * fips_kat_mldsa_key_data.inc
 *
 * FIPS 140-3 Self Test Compliance Data
 *
 * Copyright 2026 DigiCert, Inc. All Rights Reserved.
 *
 * DigiCert® TrustCore SDK and TrustEdge are licensed under a dual-license model:
 *
 * 1. **Open Source License**: GNU Affero General Public License v3.0 (AGPL v3).
 * See: https://github.com/digicert/trustcore/blob/main/LICENSE.md
 * 2. **Commercial License**: Available under DigiCert's Master Services Agreement.
 * See: https://www.digicert.com/master-services-agreement/
 *
 * *Use of TrustCore SDK or TrustEdge outside the scope of AGPL v3 requires a commercial license.*
 * *Contact DigiCert at sales@digicert.com for more details.*
 *
 */

#ifdef __ENABLE_DIGICERT_FIPS_MODULE__

/************************************************************************
 * Data values for the 'fips_kat' logic checking the ML-DSA key creation
 * algorithm.
 ************************************************************************/

static const ubyte XiGen[] = {
  0x35, 0x8e, 0x41, 0xfc, 0xdf, 0xb5, 0xe6, 0x23, 0xaf, 0xcb, 0xcf, 0xf6,
  0x6e, 0xa4, 0x8b, 0x84, 0x76, 0xb5, 0x64, 0x3c, 0x2b, 0x8f, 0xaf, 0x7d,
  0x23, 0xfa, 0x27, 0xc2, 0xc1, 0xa6, 0xd0, 0x6d
};
static const ubyte4 XiGenLen = sizeof(XiGen);

static const ubyte pubKeyGen[] = {
  0xc6, 0x42, 0x0e, 0xc7, 0x75, 0xe6, 0x43, 0xab, 0x34, 0xb6, 0xc9, 0x53,
  0xd1, 0xc5, 0xe8, 0x59, 0x6a, 0x2d, 0x4d, 0xc5, 0xdf, 0x2e, 0x52, 0xba,
  0xca, 0xc2, 0xa7, 0xab, 0x5f, 0xd6, 0x5b, 0x83, 0xd9, 0x3f, 0xef, 0x5a,
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  0x36, 0x42, 0x0b, 0x64
};
static const ubyte4 pubKeyGenLen = sizeof(pubKeyGen);

static const ubyte privKeyGen[] = {
  0xc6, 0x42, 0x0e, 0xc7, 0x75, 0xe6, 0x43, 0xab, 0x34, 0xb6, 0xc9, 0x53,
  0xd1, 0xc5, 0xe8, 0x59, 0x6a, 0x2d, 0x4d, 0xc5, 0xdf, 0x2e, 0x52, 0xba,
  0xca, 0xc2, 0xa7, 0xab, 0x5f, 0xd6, 0x5b, 0x83, 0xf9, 0x0a, 0x72, 0xe1,
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  0xad, 0x30, 0x4e, 0xa4
};
static const ubyte4 privKeyGenLen = sizeof(privKeyGen);

#endif /*  __ENABLE_DIGICERT_FIPS_MODULE__ */
