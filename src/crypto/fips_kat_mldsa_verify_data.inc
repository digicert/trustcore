/*
 * fips_kat_mldsa_data.inc
 *
 * FIPS 140-3 Self Test Compliance Data
 *
 * Copyright 2026 DigiCert, Inc. All Rights Reserved.
 *
 * DigiCert® TrustCore SDK and TrustEdge are licensed under a dual-license model:
 *
 * 1. **Open Source License**: GNU Affero General Public License v3.0 (AGPL v3).
 * See: https://github.com/digicert/trustcore/blob/main/LICENSE.md
 * 2. **Commercial License**: Available under DigiCert's Master Services Agreement.
 * See: https://www.digicert.com/master-services-agreement/
 *
 * *Use of TrustCore SDK or TrustEdge outside the scope of AGPL v3 requires a commercial license.*
 * *Contact DigiCert at sales@digicert.com for more details.*
 *
 */

#ifdef __ENABLE_DIGICERT_FIPS_MODULE__

/************************************************************************
 * Data values for the 'fips_kat' logic checking the ML-DSA verification
 * algorithm.
 ************************************************************************/

static const ubyte publicKeyVer[] = {
  0xc3, 0xc2, 0x81, 0x25, 0x27, 0xad, 0x5c, 0xc9, 0x77, 0x64, 0x5f, 0xd5,
  0xcb, 0x81, 0xd7, 0xe9, 0x0a, 0xc1, 0xf4, 0x82, 0x77, 0x0d, 0xa6, 0x03,
  0x02, 0x6f, 0x85, 0xcf, 0x38, 0xf6, 0x86, 0xfc, 0x25, 0x67, 0xdb, 0x32,
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  0xce, 0x5d, 0x5b, 0x10
};
static const ubyte4 publicKeyVerLen = sizeof(publicKeyVer);

static const ubyte msgVer[] = {
  0x9e, 0x35, 0x7f, 0xcc, 0x63, 0x79, 0x17, 0x47, 0xfd, 0xe7, 0x6f, 0x2f,
  0xb1, 0x97, 0x2d, 0x42, 0xd8, 0x55, 0x0f, 0x7c, 0xdf, 0x60, 0xd4, 0x8e,
  0x42, 0xee, 0xc8, 0x3a, 0x48, 0xdb, 0x56, 0x0c, 0x57, 0xb4, 0x3b, 0x98,
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  0xe3, 0xb6, 0x4d, 0x48
};
static const ubyte4 msgVerLen = sizeof(msgVer);

static const ubyte contextVer[] = {
  0x8a, 0xb4, 0xe6, 0x82, 0xab, 0x6f, 0xbd, 0x06, 0x0c, 0xe2, 0x63, 0xa3,
  0x02, 0x3a, 0x2b, 0x4e, 0xf1, 0xf8, 0xe6, 0xb2, 0x4d, 0x9e, 0x13, 0x19,
  0xaa, 0x9f, 0xc6, 0xd4, 0xf0, 0x70, 0xe6, 0x43, 0xc5, 0x7a, 0xa3, 0x35,
  0xc5, 0xd2, 0xf3, 0x8c, 0x0c, 0x18, 0xf9, 0xc1, 0xa8, 0xb9, 0x83, 0x00,
  0x0e, 0x88, 0x63
};
static const ubyte4 contextVerLen = sizeof(contextVer);

static const ubyte sigVer[] = {
  0x88, 0x1b, 0x28, 0x96, 0x1e, 0x9e, 0xaf, 0x3d, 0x6f, 0x97, 0x04, 0xa6,
  0x07, 0x89, 0x5f, 0x47, 0xfc, 0xfc, 0x73, 0xb8, 0x9f, 0x81, 0xc0, 0xac,
  0xa1, 0xe1, 0x55, 0x37, 0xd2, 0xdd, 0xbc, 0x99, 0xbe, 0x8d, 0x7a, 0xb6,
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  0x00, 0x00, 0x00, 0x00, 0x0c, 0x15, 0x21, 0x32
};
static const ubyte4 sigVerLen = sizeof(sigVer);

#endif /* __ENABLE_DIGICERT_FIPS_MODULE__ */
