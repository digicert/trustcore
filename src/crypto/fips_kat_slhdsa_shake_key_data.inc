/*
 * fips_kat_slhdsa_shake_sign_data.inc
 *
 * FIPS 140-3 Self Test Compliance Data
 *
 * Copyright 2026 DigiCert, Inc. All Rights Reserved.
 *
 * DigiCert® TrustCore SDK and TrustEdge are licensed under a dual-license model:
 *
 * 1. **Open Source License**: GNU Affero General Public License v3.0 (AGPL v3).
 * See: https://github.com/digicert/trustcore/blob/main/LICENSE.md
 * 2. **Commercial License**: Available under DigiCert's Master Services Agreement.
 * See: https://www.digicert.com/master-services-agreement/
 *
 * *Use of TrustCore SDK or TrustEdge outside the scope of AGPL v3 requires a commercial license.*
 * *Contact DigiCert at sales@digicert.com for more details.*
 *
 */

#ifdef __ENABLE_DIGICERT_FIPS_MODULE__

/************************************************************************
 * Data values for the 'fips_kat' logic checking the SLH-DSA key creation
 * algorithm with SHAKE digest.
 ************************************************************************/

static const ubyte pSKSeed[] = {
  0xb9, 0x8c, 0x7d, 0x9f, 0xcc, 0xe9, 0x2c, 0x2e, 0xd8, 0x20, 0xdb, 0x3a,
  0xa9, 0x21, 0x8c, 0x07
};
static const ubyte4 SKSeedLen = sizeof(pSKSeed);

static const ubyte pSKPrf[] = {
  0x4d, 0x0c, 0x13, 0x01, 0xfd, 0x03, 0x5f, 0x01, 0x95, 0x9d, 0x8a, 0x43,
  0x57, 0x32, 0x0c, 0x5c
};
static const ubyte4 SKPrfLen = sizeof(pSKPrf);

static const ubyte pPKSeed[] = {
  0xf6, 0x8a, 0xfc, 0x7a, 0x0b, 0xd8, 0xd8, 0x0b, 0x0c, 0x33, 0xd1, 0x78,
  0x6a, 0xcd, 0xed, 0x14
};
static const ubyte4 PKSeedLen = sizeof(pPKSeed);

static const ubyte skVal[] = {
  0xb9, 0x8c, 0x7d, 0x9f, 0xcc, 0xe9, 0x2c, 0x2e, 0xd8, 0x20, 0xdb, 0x3a,
  0xa9, 0x21, 0x8c, 0x07, 0x4d, 0x0c, 0x13, 0x01, 0xfd, 0x03, 0x5f, 0x01,
  0x95, 0x9d, 0x8a, 0x43, 0x57, 0x32, 0x0c, 0x5c, 0xf6, 0x8a, 0xfc, 0x7a,
  0x0b, 0xd8, 0xd8, 0x0b, 0x0c, 0x33, 0xd1, 0x78, 0x6a, 0xcd, 0xed, 0x14,
  0xa9, 0xe6, 0x15, 0x2a, 0xce, 0x0d, 0x08, 0x0c, 0x8e, 0x04, 0xe3, 0x57,
  0x71, 0xfa, 0xb1, 0xf7
};
static const ubyte4 skValLen = sizeof(skVal);

#endif /* __ENABLE_DIGICERT_FIPS_MODULE__ */
