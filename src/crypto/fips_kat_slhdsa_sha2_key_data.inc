/*
 * fips_kat_slhdsa_sha2_sign_data.inc
 *
 * FIPS 140-3 Self Test Compliance Data
 *
 * Copyright 2026 DigiCert, Inc. All Rights Reserved.
 *
 * DigiCert® TrustCore SDK and TrustEdge are licensed under a dual-license model:
 *
 * 1. **Open Source License**: GNU Affero General Public License v3.0 (AGPL v3).
 * See: https://github.com/digicert/trustcore/blob/main/LICENSE.md
 * 2. **Commercial License**: Available under DigiCert's Master Services Agreement.
 * See: https://www.digicert.com/master-services-agreement/
 *
 * *Use of TrustCore SDK or TrustEdge outside the scope of AGPL v3 requires a commercial license.*
 * *Contact DigiCert at sales@digicert.com for more details.*
 *
 */

#ifdef __ENABLE_DIGICERT_FIPS_MODULE__

/************************************************************************
 * Data values for the 'fips_kat' logic checking the SLH-DSA key creation
 * algorithm with SHA2 digest.
 ************************************************************************/

static const ubyte pSKSeed[] = {
  0xf6, 0xf9, 0xc0, 0x60, 0x99, 0x89, 0xd9, 0x0d, 0xc7, 0x2c, 0x2b, 0x71,
  0xdf, 0x91, 0x03, 0xa3
};
static const ubyte4 SKSeedLen = sizeof(pSKSeed);

static const ubyte pSKPrf[] = {
  0x5a, 0xe5, 0x9d, 0x14, 0xa2, 0x31, 0xd3, 0xb0, 0x46, 0x9c, 0xe1, 0xd0,
  0x3f, 0xcb, 0xae, 0x82
};
static const ubyte4 SKPrfLen = sizeof(pSKPrf);

static const ubyte pPKSeed[] = {
  0x4d, 0x35, 0xe1, 0xac, 0xbf, 0xb1, 0x7f, 0x77, 0x64, 0xf0, 0xaa, 0xed,
  0x6c, 0x27, 0xf1, 0xc0
};
static const ubyte4 PKSeedLen = sizeof(pPKSeed);

static const ubyte skVal[] = {
  0xf6, 0xf9, 0xc0, 0x60, 0x99, 0x89, 0xd9, 0x0d, 0xc7, 0x2c, 0x2b, 0x71,
  0xdf, 0x91, 0x03, 0xa3, 0x5a, 0xe5, 0x9d, 0x14, 0xa2, 0x31, 0xd3, 0xb0,
  0x46, 0x9c, 0xe1, 0xd0, 0x3f, 0xcb, 0xae, 0x82, 0x4d, 0x35, 0xe1, 0xac,
  0xbf, 0xb1, 0x7f, 0x77, 0x64, 0xf0, 0xaa, 0xed, 0x6c, 0x27, 0xf1, 0xc0,
  0xfb, 0xdb, 0x04, 0x40, 0xed, 0xc2, 0xb3, 0x50, 0xd2, 0x4d, 0xe1, 0x56,
  0xb6, 0xbb, 0x80, 0xcf
};
static const ubyte4 skValLen = sizeof(skVal);

#endif /* __ENABLE_DIGICERT_FIPS_MODULE__ */
