/*
 * fips_kat_mlkem_encap_data.inc
 *
 * FIPS 140-3 Self Test Compliance Data
 *
 * Copyright 2026 DigiCert, Inc. All Rights Reserved.
 *
 * DigiCert® TrustCore SDK and TrustEdge are licensed under a dual-license model:
 *
 * 1. **Open Source License**: GNU Affero General Public License v3.0 (AGPL v3).
 * See: https://github.com/digicert/trustcore/blob/main/LICENSE.md
 * 2. **Commercial License**: Available under DigiCert's Master Services Agreement.
 * See: https://www.digicert.com/master-services-agreement/
 *
 * *Use of TrustCore SDK or TrustEdge outside the scope of AGPL v3 requires a commercial license.*
 * *Contact DigiCert at sales@digicert.com for more details.*
 *
 */

#ifdef __ENABLE_DIGICERT_FIPS_MODULE__

/************************************************************************
 * Data values for the 'fips_kat' logic checking the ML-KEM key encapsulation
 * algorithm.
 ************************************************************************/

static const ubyte msgEnc[] = {
	0x45, 0xc0, 0x40, 0xc0, 0x7e, 0xcb, 0x57, 0x9f, 0x50, 0xab, 0xc8, 0x93,
	0xfe, 0x1f, 0xd7, 0x89, 0x20, 0xe4, 0x0d, 0x4e, 0x2f, 0x1d, 0x29, 0x12,
	0x85, 0x7a, 0x8b, 0x62, 0x4f, 0x4b, 0x2a, 0x6e
    };
static const ubyte4 msgEncLen = sizeof(msgEnc);

static const ubyte ekEnc[] = {
	0x83, 0xa4, 0xc5, 0xab, 0xb0, 0x54, 0xa2, 0x07, 0xac, 0x4b, 0xca, 0x27,
	0x0e, 0x93, 0x9a, 0x40, 0x44, 0x28, 0xcb, 0x76, 0x3a, 0xaa, 0x31, 0x7d,
	0x85, 0x17, 0xcb, 0x2c, 0xc3, 0xa8, 0x51, 0xc2, 0xbe, 0x35, 0x55, 0x84,
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	0xfc, 0x97, 0xda, 0x7e, 0xcb, 0x65, 0x4d, 0x40
    };
static const ubyte4 ekEncLen = sizeof(ekEnc);

static const ubyte cryptEncExpect [] = {
	0xa9, 0xdd, 0x96, 0x94, 0x27, 0xf5, 0x4c, 0x0f, 0xe5, 0x84, 0xa8, 0xd0,
	0x62, 0x28, 0x97, 0xd3, 0x68, 0x97, 0xad, 0x52, 0xea, 0xb4, 0x77, 0x81,
	0x68, 0x68, 0x2e, 0x42, 0x4a, 0x8d, 0xc3, 0x8e, 0x56, 0xab, 0x7e, 0xa8,
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	0x8a, 0xed, 0x5f, 0x85, 0x4a, 0x76, 0x96, 0x55, 0x7a, 0x67, 0x3e, 0x3f
    };
static const ubyte4 cryptEncExpectLen = sizeof(cryptEncExpect);

static const ubyte keyEncExpect [] = {
	0x19, 0x24, 0xed, 0xa3, 0xfd, 0x48, 0x74, 0xd2, 0x5c, 0x94, 0x60, 0x46,
	0x77, 0x71, 0xc5, 0x48, 0x5d, 0x3c, 0x67, 0xbf, 0xac, 0xa6, 0x61, 0x68,
	0x5b, 0xfc, 0x27, 0x0f, 0x1b, 0xdb, 0x92, 0xe4
    };
static const ubyte4 keyEncExpectLen = sizeof(keyEncExpect);

#endif /* __ENABLE_DIGICERT_FIPS_MODULE__ */
