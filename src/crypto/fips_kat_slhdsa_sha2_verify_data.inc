/*
 * fips_kat_slhdsa_sha2_verify_data.inc
 *
 * FIPS 140-3 Self Test Compliance Data
 *
 * Copyright 2025 DigiCert Project Authors. All Rights Reserved.
 * 
 * DigiCert® TrustCore and TrustEdge are licensed under a dual-license model:
 * - **Open Source License**: GNU AGPL v3. See: https://github.com/digicert/trustcore-test/blob/main/LICENSE
 * - **Commercial License**: Available under DigiCert’s Master Services Agreement. See: https://github.com/digicert/trustcore-test/blob/main/LICENSE_COMMERCIAL.txt  
 *   or https://www.digicert.com/master-services-agreement/
 * 
 * *For commercial licensing, contact DigiCert at sales@digicert.com.*
 *
 */

#ifdef __ENABLE_DIGICERT_FIPS_MODULE__

/************************************************************************
 * Data values for the 'fips_kat' logic checking the SLH-DSA verification
 * algorithm with SHA2 digest.
 ************************************************************************/

static const ubyte msg[] = {
  0x1a, 0xc7, 0x1e, 0x82, 0x12, 0x8f, 0x57, 0x21, 0xbb, 0x17, 0x67, 0xd2,
  0x7b, 0x7d, 0xac, 0x04, 0xae, 0xe6, 0x4e, 0x59, 0x17, 0x42, 0x7d, 0xa8,
  0x41, 0xce, 0x0b, 0x81, 0xc2, 0x11, 0x73, 0x5b, 0x5e, 0x1b, 0x0e, 0x19,
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  0x9c, 0x03, 0x80, 0xa4, 0x89, 0x02, 0x04, 0x11
};
static const ubyte4 msgLen = sizeof(msg);

static const ubyte context[] = {
  0x04, 0x7d, 0x93, 0xc3, 0x29, 0x9c, 0x97, 0xc3, 0x49, 0x1f, 0xcf, 0xd5,
  0x6f, 0x57, 0xa6, 0xd9, 0x62, 0x07, 0x5a, 0xff, 0x39, 0x51, 0x16, 0xa8,
  0x52, 0xee, 0xb2, 0xe3, 0x85, 0x9a, 0x82, 0xd9, 0xf2, 0xba, 0x8d, 0xcc,
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  0x9d, 0xd4, 0x2a, 0xcb, 0x46, 0x98, 0x29, 0x3b, 0x13, 0x27, 0x81, 0xd1
};
static const ubyte4 contextLen = sizeof(context);

static const ubyte pPublicKey[] = {
  0x86, 0xe0, 0xdf, 0x3e, 0x4e, 0x03, 0x71, 0x93, 0xb1, 0xe0, 0x40, 0x2f,
  0x51, 0x4b, 0xdd, 0x8b, 0xef, 0x44, 0x65, 0xb5, 0x65, 0xec, 0x01, 0xbf,
  0x78, 0xc2, 0x1a, 0x0b, 0x79, 0x4f, 0xfb, 0x3b
};
static const ubyte4 publicKeyLen = sizeof(pPublicKey);

static const ubyte pSignature[] = {
  0x04, 0x75, 0xb5, 0x68, 0x19, 0x60, 0x06, 0xe2, 0x1f, 0x16, 0x84, 0xbb,
  0x19, 0x54, 0x72, 0x4f, 0x13, 0x92, 0x17, 0x4e, 0x1e, 0x97, 0x34, 0x96,
  0x5a, 0x53, 0xa0, 0x57, 0xd1, 0x92, 0xe2, 0xc2, 0x71, 0x06, 0x68, 0x60,
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  0x82, 0x3c, 0xb1, 0x07, 0xb8, 0x5c, 0xfe, 0x06
};
static const ubyte4 signatureLen = sizeof(pSignature);

#endif /* __ENABLE_DIGICERT_FIPS_MODULE__ */

