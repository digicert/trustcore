/*
 * fips_kat_mlkem_key_data.inc
 *
 * FIPS 140-3 Self Test Compliance Data
 *
 * Copyright 2026 DigiCert, Inc. All Rights Reserved.
 *
 * DigiCert® TrustCore SDK and TrustEdge are licensed under a dual-license model:
 *
 * 1. **Open Source License**: GNU Affero General Public License v3.0 (AGPL v3).
 * See: https://github.com/digicert/trustcore/blob/main/LICENSE.md
 * 2. **Commercial License**: Available under DigiCert's Master Services Agreement.
 * See: https://www.digicert.com/master-services-agreement/
 *
 * *Use of TrustCore SDK or TrustEdge outside the scope of AGPL v3 requires a commercial license.*
 * *Contact DigiCert at sales@digicert.com for more details.*
 *
 */

#ifdef __ENABLE_DIGICERT_FIPS_MODULE__

/************************************************************************
 * Data values for the 'fips_kat' logic checking the ML-KEM key creation
 * algorithm.
 ************************************************************************/

static const ubyte  zGen[] = {
	0xcc, 0x6b, 0xde, 0x58, 0x86, 0x60, 0x11, 0x9a, 0xdb, 0x04, 0x5d, 0x22,
	0x58, 0x9c, 0xee, 0x34, 0x31, 0xc9, 0xea, 0x23, 0x5d, 0x52, 0xe7, 0xc7,
	0xb6, 0x7f, 0x24, 0x53, 0x9e, 0xfc, 0x53, 0x72
    };
static const ubyte4 zGenLen = sizeof(zGen);

static const ubyte  dGen[] = {
	0xe9, 0x5d, 0xf8, 0xc3, 0x41, 0x03, 0x21, 0x4e, 0x14, 0x54, 0xb7, 0xd6,
	0x01, 0x1f, 0x48, 0x5f, 0xc2, 0xae, 0x23, 0x1b, 0x39, 0x44, 0xf9, 0x54,
	0xcc, 0x73, 0x34, 0x6f, 0x12, 0xda, 0xe4, 0x65
    };
static const ubyte4 dGenLen = sizeof(dGen);

static const ubyte ekGenExpect[] = {
	0x11, 0x4a, 0xbd, 0x94, 0x67, 0xa2, 0x44, 0x8c, 0x39, 0xbc, 0xdb, 0x09,
        0xdf, 0x72, 0xc2, 0xc7, 0xc2, 0xbc, 0xb0, 0x05, 0xc8, 0x56, 0xc1, 0xa4,
	0x3e, 0x9a, 0x92, 0x9b, 0x8b, 0x3e, 0x52, 0x90, 0xbc, 0xc6, 0xdc, 0x16,
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	0x43, 0x7f, 0x2b, 0xac, 0xe8, 0x0b, 0x22, 0xe2
    };
static const ubyte4 ekGenExpectLen = sizeof(ekGenExpect);

static const ubyte dkGenExpect[] = {
	0x90, 0xf3, 0x87, 0xf9, 0x7c, 0x1f, 0x59, 0xe5, 0x96, 0x7d, 0x30, 0xcd,
	0x74, 0x07, 0xa6, 0x06, 0x6c, 0x14, 0xba, 0x2c, 0xa2, 0x7f, 0xda, 0x37,
	0xeb, 0x5c, 0x2e, 0x15, 0x29, 0x02, 0x3d, 0x27, 0xca, 0x06, 0xcb, 0x4d,
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	0x5d, 0x52, 0xe7, 0xc7, 0xb6, 0x7f, 0x24, 0x53, 0x9e, 0xfc, 0x53, 0x72
    };
static const ubyte4 dkGenExpectLen = sizeof(dkGenExpect);

#endif /* __ENABLE_DIGICERT_FIPS_MODULE__ */
